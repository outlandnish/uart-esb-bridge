## CMakeLists.txt
```
# SPDX-License-Identifier: Apache-2.0

cmake_minimum_required(VERSION 3.20.0)

find_package(Zephyr REQUIRED HINTS $ENV{ZEPHYR_BASE})
project(esb_link)

target_sources(app PRIVATE 
    src/main.c
    src/esb.c
)

# Include directories
target_include_directories(app PRIVATE
    ${CMAKE_CURRENT_SOURCE_DIR}/include
)
```

## prj.conf
```kconfig
# Zephyr Configuration for nRF52840 USB-UART-Gazelle Bridge

# Enable USB device support
CONFIG_USB_DEVICE_STACK=y
CONFIG_USB_DEVICE_MANUFACTURER="Gazelle Link"
CONFIG_USB_DEVICE_PRODUCT="USB-UART Bridge"
CONFIG_USB_DEVICE_VID=0x2FE3
CONFIG_USB_DEVICE_PID=0x0100

# Enable USB CDC ACM (USB Serial)
CONFIG_USB_CDC_ACM=y
CONFIG_USB_CDC_ACM_RINGBUF_SIZE=1024
CONFIG_USB_CDC_ACM_DEVICE_NAME="CDC_ACM"

# Enable UART
CONFIG_SERIAL=y
CONFIG_UART_INTERRUPT_DRIVEN=y
CONFIG_UART_LINE_CTRL=y
CONFIG_UART_USE_RUNTIME_CONFIGURE=y

# Enable console
CONFIG_CONSOLE=y
CONFIG_UART_CONSOLE=y
CONFIG_USB_UART_CONSOLE=y

# Enable logging
CONFIG_LOG=y
CONFIG_LOG_DEFAULT_LEVEL=3
CONFIG_USB_CDC_ACM_LOG_LEVEL_DBG=y

# Enable GPIO for LED indicators
CONFIG_GPIO=y

# Enable Nordic Gazelle protocol
CONFIG_NRF_GZLL=y
CONFIG_NRF_GZLL_MAX_PAYLOAD_LENGTH=32

# Enable MPSL (Multi Protocol Service Layer)
CONFIG_MPSL=y
CONFIG_MPSL_FEM=n

# Enable ESB (Enhanced ShockBurst) - required for Gazelle
CONFIG_ESB=y

# Memory settings
CONFIG_MAIN_STACK_SIZE=2048
CONFIG_SYSTEM_WORKQUEUE_STACK_SIZE=2048

# Enable threading
CONFIG_MULTITHREADING=y
CONFIG_NUM_PREEMPT_PRIORITIES=15
```

## prj_device.conf
```kconfig
# Zephyr Configuration for nRF52840 USB-UART-ESB Bridge (DEVICE)

# Enable USB device support
CONFIG_USB_DEVICE_STACK=y
CONFIG_USB_DEVICE_MANUFACTURER="ESB Link"
CONFIG_USB_DEVICE_PRODUCT="USB-UART ESB Bridge Device"
CONFIG_USB_DEVICE_VID=0x2FE3
CONFIG_USB_DEVICE_PID=0x0101

# Enable USB CDC ACM (USB Serial)
CONFIG_USB_CDC_ACM=y
CONFIG_USB_CDC_ACM_RINGBUF_SIZE=1024
CONFIG_USB_CDC_ACM_DEVICE_NAME="CDC_ACM"

# Enable UART
CONFIG_SERIAL=y
CONFIG_UART_INTERRUPT_DRIVEN=y
CONFIG_UART_LINE_CTRL=y
CONFIG_UART_USE_RUNTIME_CONFIGURE=y

# Enable console
CONFIG_CONSOLE=y
CONFIG_UART_CONSOLE=y
CONFIG_USB_UART_CONSOLE=y

# Enable logging
CONFIG_LOG=y
CONFIG_LOG_DEFAULT_LEVEL=3
CONFIG_USB_CDC_ACM_LOG_LEVEL_DBG=y

# Enable GPIO for LED indicators
CONFIG_GPIO=y

# Enable Nordic Enhanced ShockBurst (ESB) protocol
CONFIG_ESB=y
CONFIG_ESB_MAX_PAYLOAD_LENGTH=252

# Enable MPSL (Multi Protocol Service Layer)
CONFIG_MPSL=y
CONFIG_MPSL_FEM=n

# Memory settings
CONFIG_MAIN_STACK_SIZE=2048
CONFIG_SYSTEM_WORKQUEUE_STACK_SIZE=2048

# Enable threading
CONFIG_MULTITHREADING=y
CONFIG_NUM_PREEMPT_PRIORITIES=15
```

## prj_host.conf
```kconfig
# Zephyr Configuration for nRF52840 USB-UART-ESB Bridge (HOST)

# Enable USB device support
CONFIG_USB_DEVICE_STACK=y
CONFIG_USB_DEVICE_MANUFACTURER="ESB Link"
CONFIG_USB_DEVICE_PRODUCT="USB-UART ESB Bridge Host"
CONFIG_USB_DEVICE_VID=0x2FE3
CONFIG_USB_DEVICE_PID=0x0100

# Enable USB CDC ACM (USB Serial)
CONFIG_USB_CDC_ACM=y
CONFIG_USB_CDC_ACM_RINGBUF_SIZE=1024
CONFIG_USB_CDC_ACM_DEVICE_NAME="CDC_ACM"

# Enable UART
CONFIG_SERIAL=y
CONFIG_UART_INTERRUPT_DRIVEN=y
CONFIG_UART_LINE_CTRL=y
CONFIG_UART_USE_RUNTIME_CONFIGURE=y

# Enable console
CONFIG_CONSOLE=y
CONFIG_UART_CONSOLE=y
CONFIG_USB_UART_CONSOLE=y

# Enable logging
CONFIG_LOG=y
CONFIG_LOG_DEFAULT_LEVEL=3
CONFIG_USB_CDC_ACM_LOG_LEVEL_DBG=y

# Enable GPIO for LED indicators
CONFIG_GPIO=y

# Enable Nordic Enhanced ShockBurst (ESB) protocol
CONFIG_ESB=y
CONFIG_ESB_MAX_PAYLOAD_LENGTH=252

# Enable MPSL (Multi Protocol Service Layer)
CONFIG_MPSL=y
CONFIG_MPSL_FEM=n

# Memory settings
CONFIG_MAIN_STACK_SIZE=2048
CONFIG_SYSTEM_WORKQUEUE_STACK_SIZE=2048

# Enable threading
CONFIG_MULTITHREADING=y
CONFIG_NUM_PREEMPT_PRIORITIES=15
```

## src/main.c
```c
/*
 * nRF52840 USB-UART-ESB Bridge
 * 
 * This firmware creates a USB-UART bridge using the Enhanced ShockBurst (ESB) protocol
 * to communicate with another identical nRF52840 board.
 */

#include <zephyr/kernel.h>
#include <zephyr/device.h>
#include <zephyr/drivers/uart.h>
#include <zephyr/usb/usb_device.h>
#include <zephyr/usb/class/usb_cdc.h>
#include <zephyr/drivers/gpio.h>
#include <zephyr/logging/log.h>
#include "esb_link.h"

LOG_MODULE_REGISTER(esb_link, LOG_LEVEL_DBG);

/* LED definitions for status indication */
#define LED0_NODE DT_ALIAS(led0)
#define LED1_NODE DT_ALIAS(led1)
#define LED2_NODE DT_ALIAS(led2)

static const struct gpio_dt_spec led0 = GPIO_DT_SPEC_GET(LED0_NODE, gpios);
static const struct gpio_dt_spec led1 = GPIO_DT_SPEC_GET(LED1_NODE, gpios);
static const struct gpio_dt_spec led2 = GPIO_DT_SPEC_GET(LED2_NODE, gpios);

/* USB CDC ACM device */
static const struct device *const usb_dev = DEVICE_DT_GET_ONE(zephyr_cdc_acm_uart);

/* UART device for 1Mbps communication */
static const struct device *const uart_dev = DEVICE_DT_GET(DT_CHOSEN(zephyr_shell_uart));

/* Buffer sizes */
#define BUFFER_SIZE 1024
#define RING_BUF_SIZE 4096

/* Data buffers */
static uint8_t usb_rx_buffer[BUFFER_SIZE];
static uint8_t uart_rx_buffer[BUFFER_SIZE];
static uint8_t esb_rx_buffer[BUFFER_SIZE];

/* Ring buffers for data flow */
RING_BUF_DECLARE(usb_to_esb_rb, RING_BUF_SIZE);
RING_BUF_DECLARE(esb_to_usb_rb, RING_BUF_SIZE);

/* Forward declarations */
static void usb_cdc_interrupt_handler(const struct device *dev, void *user_data);
static void uart_interrupt_handler(const struct device *dev, void *user_data);
static void configure_leds(void);
static void configure_usb_cdc(void);
static void configure_uart_1mbps(void);
static void configure_esb(void);
static void esb_rx_handler(esb_packet_t *packet);
static void esb_tx_complete_handler(uint8_t pipe_id, bool success);
static void esb_error_handler(uint8_t error_code);

/* LED status functions */
static void led_set_usb_status(bool connected)
{
    gpio_pin_set_dt(&led0, connected ? 1 : 0);
}

static void led_set_esb_status(bool connected)
{
    gpio_pin_set_dt(&led1, connected ? 1 : 0);
}

static void led_set_activity(bool active)
{
    gpio_pin_set_dt(&led2, active ? 1 : 0);
}

/* USB CDC ACM interrupt handler */
static void usb_cdc_interrupt_handler(const struct device *dev, void *user_data)
{
    ARG_UNUSED(user_data);
    
    uint8_t buffer[BUFFER_SIZE];
    int bytes_read;
    
    while (uart_irq_update(dev) && uart_irq_is_pending(dev)) {
        if (uart_irq_rx_ready(dev)) {
            bytes_read = uart_fifo_read(dev, buffer, sizeof(buffer));
            if (bytes_read > 0) {
                LOG_DBG("USB RX: %d bytes", bytes_read);
                
                /* Put data into ring buffer for ESB transmission */
                uint32_t written = ring_buf_put(&usb_to_esb_rb, buffer, bytes_read);
                if (written < bytes_read) {
                    LOG_WRN("USB RX buffer overflow, lost %d bytes", bytes_read - written);
                }
                
                led_set_activity(true);
            }
        }
    }
}

/* UART interrupt handler */
static void uart_interrupt_handler(const struct device *dev, void *user_data)
{
    ARG_UNUSED(user_data);
    
    uint8_t buffer[BUFFER_SIZE];
    int bytes_read;
    
    while (uart_irq_update(dev) && uart_irq_is_pending(dev)) {
        if (uart_irq_rx_ready(dev)) {
            bytes_read = uart_fifo_read(dev, buffer, sizeof(buffer));
            if (bytes_read > 0) {
                LOG_DBG("UART RX: %d bytes", bytes_read);
                
                /* Put data into ring buffer for USB transmission */
                uint32_t written = ring_buf_put(&esb_to_usb_rb, buffer, bytes_read);
                if (written < bytes_read) {
                    LOG_WRN("UART RX buffer overflow, lost %d bytes", bytes_read - written);
                }
                
                led_set_activity(true);
            }
        }
    }
}

/* Configure LEDs for status indication */
static void configure_leds(void)
{
    if (!gpio_is_ready_dt(&led0) || !gpio_is_ready_dt(&led1) || !gpio_is_ready_dt(&led2)) {
        LOG_ERR("LEDs not ready");
        return;
    }
    
    gpio_pin_configure_dt(&led0, GPIO_OUTPUT_INACTIVE);
    gpio_pin_configure_dt(&led1, GPIO_OUTPUT_INACTIVE);
    gpio_pin_configure_dt(&led2, GPIO_OUTPUT_INACTIVE);
    
    LOG_INF("LEDs configured");
}

/* Configure USB CDC ACM */
static void configure_usb_cdc(void)
{
    int ret;
    
    if (!device_is_ready(usb_dev)) {
        LOG_ERR("USB CDC ACM device not ready");
        return;
    }
    
    /* Enable USB device */
    ret = usb_enable(NULL);
    if (ret != 0) {
        LOG_ERR("Failed to enable USB: %d", ret);
        return;
    }
    
    /* Set up interrupt handler */
    uart_irq_callback_user_data_set(usb_dev, usb_cdc_interrupt_handler, NULL);
    uart_irq_rx_enable(usb_dev);
    
    LOG_INF("USB CDC ACM configured");
    led_set_usb_status(true);
}

/* Configure UART for 1Mbps communication */
static void configure_uart_1mbps(void)
{
    struct uart_config uart_cfg = {
        .baudrate = 1000000,    /* 1Mbps */
        .parity = UART_CFG_PARITY_NONE,
        .stop_bits = UART_CFG_STOP_BITS_1,
        .data_bits = UART_CFG_DATA_BITS_8,
        .flow_ctrl = UART_CFG_FLOW_CTRL_NONE
    };
    
    if (!device_is_ready(uart_dev)) {
        LOG_ERR("UART device not ready");
        return;
    }
    
    int ret = uart_configure(uart_dev, &uart_cfg);
    if (ret != 0) {
        LOG_ERR("Failed to configure UART: %d", ret);
        return;
    }
    
    /* Set up interrupt handler */
    uart_irq_callback_user_data_set(uart_dev, uart_interrupt_handler, NULL);
    uart_irq_rx_enable(uart_dev);
    
    LOG_INF("UART configured for 1Mbps");
}

/* Configure ESB protocol */
static void configure_esb(void)
{
    int ret;
    
    ret = esb_init();
    if (ret != 0) {
        LOG_ERR("Failed to initialize ESB: %d", ret);
        return;
    }
    
    ret = esb_set_callbacks(esb_rx_handler, esb_tx_complete_handler, 
                               esb_error_handler);
    if (ret != 0) {
        LOG_ERR("Failed to set ESB callbacks: %d", ret);
        return;
    }
    
    ret = esb_set_channel(ESB_CHANNEL);
    if (ret != 0) {
        LOG_ERR("Failed to set ESB channel: %d", ret);
        return;
    }
    
    ret = esb_set_power(0); /* 0 dBm */
    if (ret != 0) {
        LOG_ERR("Failed to set ESB power: %d", ret);
        return;
    }
    
    ret = esb_enable();
    if (ret != 0) {
        LOG_ERR("Failed to enable ESB: %d", ret);
        return;
    }
    
    LOG_INF("ESB configured and enabled");
    led_set_esb_status(true);
}

/* ESB RX handler */
static void esb_rx_handler(esb_packet_t *packet)
{
    if (packet == NULL || packet->length == 0) {
        LOG_WRN("Invalid ESB packet received");
        return;
    }
    
    LOG_DBG("ESB RX: pipe=%d, len=%d, rssi=%d", 
            packet->pipe_id, packet->length, packet->rssi);
    
    /* Put received data into ring buffer for USB transmission */
    uint32_t written = ring_buf_put(&esb_to_usb_rb, packet->data, packet->length);
    if (written < packet->length) {
        LOG_WRN("ESB RX buffer overflow, lost %d bytes", 
                packet->length - written);
    }
    
    led_set_activity(true);
}

/* ESB TX complete handler */
static void esb_tx_complete_handler(uint8_t pipe_id, bool success)
{
    if (success) {
        LOG_DBG("ESB TX success on pipe %d", pipe_id);
    } else {
        LOG_WRN("ESB TX failed on pipe %d", pipe_id);
    }
}

/* ESB error handler */
static void esb_error_handler(uint8_t error_code)
{
    LOG_ERR("ESB error: %d", error_code);
    
    /* Flash error LED pattern */
    for (int i = 0; i < 5; i++) {
        led_set_esb_status(false);
        k_msleep(100);
        led_set_esb_status(true);
        k_msleep(100);
    }
}

/* Data bridge thread */
static void data_bridge_thread(void *arg1, void *arg2, void *arg3)
{
    ARG_UNUSED(arg1);
    ARG_UNUSED(arg2);
    ARG_UNUSED(arg3);
    
    uint8_t buffer[BUFFER_SIZE];
    uint32_t bytes_available;
    int bytes_written;
    int ret;
    
    LOG_INF("Data bridge thread started");
    
    while (1) {
        /* Forward data from USB to ESB */
        bytes_available = ring_buf_get(&usb_to_esb_rb, buffer, sizeof(buffer));
        if (bytes_available > 0) {
            /* Send data via ESB in chunks if necessary */
            uint32_t offset = 0;
            while (offset < bytes_available) {
                uint8_t chunk_size = MIN(ESB_DEFAULT_PAYLOAD, bytes_available - offset);
                
                ret = esb_send_packet(0, &buffer[offset], chunk_size, false);
                if (ret != 0) {
                    LOG_WRN("Failed to send ESB packet: %d", ret);
                    /* Put remaining data back in ring buffer */
                    ring_buf_put(&usb_to_esb_rb, &buffer[offset], 
                               bytes_available - offset);
                    break;
                }
                
                offset += chunk_size;
                LOG_DBG("USB->ESB: %d bytes", chunk_size);
            }
        }
        
        /* Forward data from ESB to USB */
        bytes_available = ring_buf_get(&esb_to_usb_rb, buffer, sizeof(buffer));
        if (bytes_available > 0) {
            bytes_written = uart_fifo_fill(usb_dev, buffer, bytes_available);
            if (bytes_written < bytes_available) {
                LOG_WRN("USB TX partial write: %d/%d bytes", bytes_written, bytes_available);
                /* Put remaining data back in ring buffer */
                ring_buf_put(&esb_to_usb_rb, &buffer[bytes_written], 
                           bytes_available - bytes_written);
            } else {
                LOG_DBG("ESB->USB: %d bytes", bytes_written);
            }
        }
        
        /* Brief sleep to prevent busy-waiting */
        k_msleep(1);
        
        /* Turn off activity LED */
        led_set_activity(false);
    }
}

/* Define the data bridge thread */
K_THREAD_DEFINE(bridge_thread, 2048, data_bridge_thread, NULL, NULL, NULL, 5, 0, 0);

/* Main function */
int main(void)
{
    #if ESB_DEVICE_MODE == 0
    LOG_INF("nRF52840 USB-UART-ESB Bridge starting in HOST mode...");
    #else
    LOG_INF("nRF52840 USB-UART-ESB Bridge starting in DEVICE mode...");
    #endif
    
    /* Configure hardware */
    configure_leds();
    configure_usb_cdc();
    configure_uart_1mbps();
    configure_esb();
    
    LOG_INF("Bridge initialized, ready for operation");
    
    /* Main loop for status monitoring */
    while (1) {
        /* Monitor buffer usage and implement flow control */
        uint32_t usb_to_esb_used = ring_buf_size_get(&usb_to_esb_rb);
        uint32_t esb_to_usb_used = ring_buf_size_get(&esb_to_usb_rb);
        
        /* Log buffer usage warnings */
        if (usb_to_esb_used > RING_BUF_SIZE * 0.8 || 
            esb_to_usb_used > RING_BUF_SIZE * 0.8) {
            LOG_WRN("Buffer usage high - USB->ESB: %d, ESB->USB: %d", 
                    usb_to_esb_used, esb_to_usb_used);
        }
        
        /* Monitor ESB connectivity */
        if (!esb_is_enabled()) {
            LOG_ERR("ESB connection lost, attempting to re-enable");
            led_set_esb_status(false);
            
            /* Attempt to re-enable ESB */
            if (esb_enable() == 0) {
                LOG_INF("ESB re-enabled successfully");
                led_set_esb_status(true);
            } else {
                LOG_ERR("Failed to re-enable ESB");
            }
        }
        
        /* Log statistics periodically */
        static uint32_t last_stats_time = 0;
        uint32_t current_time = k_uptime_get_32();
        if (current_time - last_stats_time >= 10000) { /* Every 10 seconds */
            LOG_INF("Stats - Sent: %d, Received: %d, Lost: %d", 
                    esb_get_packets_sent(),
                    esb_get_packets_received(), 
                    esb_get_packets_lost());
            last_stats_time = current_time;
        }
        
        /* Sleep for status monitoring interval */
        k_msleep(1000);
    }
    
    return 0;
}
```

## include/esb_link.h
```c
/*
 * ESB Protocol Communication Header
 * 
 * This header defines the interface for Nordic Enhanced ShockBurst (ESB) protocol
 * communication between nRF52840 boards.
 */

#ifndef ESB_LINK_H
#define ESB_LINK_H

#include <zephyr/kernel.h>
#include <stdint.h>
#include <stdbool.h>

/* ESB configuration */
#define ESB_CHANNEL             2       /* RF channel (0-100) */
#define ESB_PIPE_COUNT          8       /* Number of data pipes */
#define ESB_MAX_PAYLOAD         252     /* Maximum payload per packet (ESB supports up to 252) */
#define ESB_DEFAULT_PAYLOAD     32      /* Default payload size for compatibility */

/* Device mode is set by build flag ESB_DEVICE_MODE (0=Primary TX, 1=Primary RX) */
#ifndef ESB_DEVICE_MODE
#define ESB_DEVICE_MODE         0       /* Default to Primary TX mode */
#endif

/* ESB packet structure */
typedef struct {
    uint8_t pipe_id;
    uint8_t length;
    uint8_t data[ESB_MAX_PAYLOAD];
    int8_t rssi;
    uint32_t timestamp;
    bool no_ack;
} esb_packet_t;

/* ESB callbacks */
typedef void (*esb_rx_callback_t)(esb_packet_t *packet);
typedef void (*esb_tx_complete_callback_t)(uint8_t pipe_id, bool success);
typedef void (*esb_error_callback_t)(uint8_t error_code);

/* ESB API functions */
int esb_init(void);
int esb_enable(void);
int esb_disable(void);
int esb_set_callbacks(esb_rx_callback_t rx_cb, 
                     esb_tx_complete_callback_t tx_cb,
                     esb_error_callback_t err_cb);
int esb_send_packet(uint8_t pipe_id, uint8_t *data, uint8_t length, bool no_ack);
int esb_set_channel(uint8_t channel);
int esb_set_power(int8_t power_dbm);
int esb_set_bitrate(uint32_t bitrate); /* 1Mbps, 2Mbps */
int esb_set_crc(uint8_t crc_length);   /* 0=off, 1=8bit, 2=16bit */
bool esb_is_enabled(void);
uint32_t esb_get_packets_sent(void);
uint32_t esb_get_packets_received(void);
uint32_t esb_get_packets_lost(void);

#endif /* ESB_LINK_H */
```

## include/gazelle_link.h
```c
/*
 * Gazelle Protocol Communication Header
 * 
 * This header defines the interface for Nordic Gazelle protocol
 * communication between nRF52840 boards.
 */

#ifndef GAZELLE_LINK_H
#define GAZELLE_LINK_H

#include <zephyr/kernel.h>
#include <stdint.h>
#include <stdbool.h>

/* Gazelle configuration */
#define GAZELLE_CHANNEL         2       /* RF channel (0-100) */
#define GAZELLE_PIPE_COUNT      8       /* Number of data pipes */
#define GAZELLE_MAX_PAYLOAD     32      /* Maximum payload per packet */
#define GAZELLE_TIMESLOT_PERIOD 600     /* Timeslot period in microseconds */

/* Device mode is set by build flag GAZELLE_DEVICE_MODE (0=Host, 1=Device) */
#ifndef GAZELLE_DEVICE_MODE
#define GAZELLE_DEVICE_MODE     0       /* Default to Host mode */
#endif

/* Gazelle packet structure */
typedef struct {
    uint8_t pipe_id;
    uint8_t length;
    uint8_t data[GAZELLE_MAX_PAYLOAD];
    uint8_t rssi;
    uint32_t timestamp;
} gazelle_packet_t;

/* Gazelle callbacks */
typedef void (*gazelle_rx_callback_t)(gazelle_packet_t *packet);
typedef void (*gazelle_tx_complete_callback_t)(uint8_t pipe_id, bool success);
typedef void (*gazelle_error_callback_t)(uint8_t error_code);

/* Gazelle API functions */
int gazelle_init(void);
int gazelle_enable(void);
int gazelle_disable(void);
int gazelle_set_callbacks(gazelle_rx_callback_t rx_cb, 
                         gazelle_tx_complete_callback_t tx_cb,
                         gazelle_error_callback_t err_cb);
int gazelle_send_packet(uint8_t pipe_id, uint8_t *data, uint8_t length);
int gazelle_set_channel(uint8_t channel);
int gazelle_set_power(int8_t power_dbm);
bool gazelle_is_enabled(void);
uint32_t gazelle_get_packets_sent(void);
uint32_t gazelle_get_packets_received(void);
uint32_t gazelle_get_packets_lost(void);

#endif /* GAZELLE_LINK_H */
```

## include/timeslot.h
```c
/*
 * Copyright (c) 2021 Daniel Veilleux
 *
 * SPDX-License-Identifier: LicenseRef-Nordic-5-Clause
 */

#ifndef TIMESLOT_H__
#define TIMESLOT_H__

#ifdef __cplusplus
extern "C" {
#endif

#include <mpsl_timeslot.h>

/**
 * An interrupt vector to use with the Radio Notification feature as well as lowering the
 * priority of the MPSL callback (Zero Latency IRQ workaround). As of NCS v1.6 this doesn't
 * handle MPSL_TIMESLOT_SIGNAL_TIMER0 signals correctly unless it uses priority MPSL_LOW_PRIO
 * or higher.
 */
#define TIMESLOT_IRQN          QDEC_IRQn
#define TIMESLOT_IRQ_NODELABEL qdec
#define TIMESLOT_IRQ_PRIO      4

/**
 * If TIMESLOT_CALLS_RADIO_IRQHANDLER is set then RADIO_IRQHandler() will be called
 * directly instead of executing the radio_irq callback.
 */
#define TIMESLOT_CALLS_RADIO_IRQHANDLER 1

enum TIMESLOT_ERROR
{
    /**
     * Could not get a granted timeslot using an "earliest" request. len_us is probably
     * too long for the current Connection Interval.
     */
    TIMESLOT_ERROR_REQUESTS_FAILED = 94,
    /** The MPSL complained because the timeslot did not close on time. */
    TIMESLOT_ERROR_OVERSTAYED = 93,
    /** Something unexpected happened. */
    TIMESLOT_ERROR_INTERNAL = 92,
    /** The timeslot_open function was called twice. */
    TIMESLOT_ERROR_SESSION_ALREADY_OPENED = 91,
    /**
     * The timeslot_start function was called before timeslot_stop completed (and executed
     * the stopped callback).
     */
    TIMESLOT_ERROR_TIMESLOT_ALREADY_STARTED = 90,
    /** The timeslot_stop function was called twice. */
    TIMESLOT_ERROR_NO_TIMESLOT_STARTED = 89,
    /** A required pointer was not included in an argument. */
    TIMESLOT_ERROR_INVALID_PARAM = 88
};

struct timeslot_config {
    /**
     * High frequency clock source, see MPSL_TIMESLOT_HFCLK_CFG.
     */
    uint8_t hfclk;        
    /**
     * Amount of time before a request times out.
     */
    uint32_t timeout_us;
    /**
     * Close the timeslot this amount of time before the end to ensure that it closes cleanly.
     */
    uint32_t safety_margin_us;
    /**
     * The number of skipped timeslots before an error is raised.
     */
    uint8_t skipped_tolerance;
};

#define TS_DEFAULT_CONFIG { \
    .hfclk             = MPSL_TIMESLOT_HFCLK_CFG_XTAL_GUARANTEED, \
    .timeout_us        = 2000000,                                 \
    .safety_margin_us  = 100,                                     \
    .skipped_tolerance = 5                                        \
}

struct timeslot_cb {
    /**
     * A (potentially unrecoverable) error has occurred. The err param will be set to a
     * TIMESLOT_ERROR or an error returned by an MPSL API call.
     */
    void (*error)(int err);
    /**
     * Called at the beginning of every timeslot.
     */
    void (*start)(void);
    /**
     * Called TS_SAFETY_MARGIN_US before the end of every timeslot.
     */
    void (*end)(void);
    /**
     * A timeslot has been blocked or cancelled. The count parameter is set to the number
     * of consecutive timeslots that have been skipped.
     */
    void (*skipped)(uint8_t count);
    /**
     * The recurring timeslot has been stopped (the session is idle).
     */
    void (*stopped)(void);

#if !TIMESLOT_USE_RADIO_IRQHANDLER
    /**
     * Some code e.g. the ESB library defines its own RADIO_IRQHandler function. Setting
     * TIMESLOT_USE_RADIO_IRQHANDLER causes MPSL_TIMESLOT_SIGNAL_RADIO signals to call
     * RADIO_IRQHandler directly. Otherwise, this callback will be used whenever RADIO_IRQHandler
     * is called.
     */
    void (*radio_irq)(void);
#endif
};

/** @brief Open an MPSL session
 * 
 * @note Opening a session is always the first step and closing a session is not implemented
 *       because there's no obvious reason to ever do it.
 *
 * @note This function should be called before Bluetooth is enabled.
 * 
 * @param[in] p_config      Pointer to a timeslot_config (should be static/global)
 * @param[in] p_cb          Pointer to a timeslot_cb (should be static/global)
 * 
 * @retval 0                                      Success
 * @retval -TIMESLOT_ERROR_SESSION_ALREADY_OPENED The session is already open
 * @retval -TIMESLOT_ERROR_INVALID_PARAM          One of the pointers was NULL
 */
int timeslot_open(struct timeslot_config *p_config, struct timeslot_cb *p_cb);

/** @brief Request a recurring timeslot of len_us
 * 
 * @param[in] len_us      Usable length will be minus safety_margin_us
 * 
 * @retval 0                                        Success
 * @retval -TIMESLOT_ERROR_TIMESLOT_ALREADY_STARTED The session is already open
 * @retval -NRF_EINVAL                              Invalid parameter
 * @retval -NRF_ENOENT                              The session is not open
 * @retval -NRF_EAGAIN                              The session is not IDLE
 */
int timeslot_start(uint32_t len_us);

/** @brief Stop requesting the recurring timeslot and allow the session to go idle
 *
 * @retval 0                                   Success
 * @retval -TIMESLOT_ERROR_NO_TIMESLOT_STARTED There is no timeslot to stop
 */
int timeslot_stop(void);

#ifdef __cplusplus
}
#endif

#endif /* TIMESLOT_H__ */

/** @} */
/*
 * Copyright (c) 2021 Daniel Veilleux
 *
 * SPDX-License-Identifier: LicenseRef-Nordic-5-Clause
 */

#ifndef TIMESLOT_H__
#define TIMESLOT_H__

#ifdef __cplusplus
extern "C" {
#endif

#include <mpsl_timeslot.h>

/**
 * An interrupt vector to use with the Radio Notification feature as well as lowering the
 * priority of the MPSL callback (Zero Latency IRQ workaround). As of NCS v1.6 this doesn't
 * handle MPSL_TIMESLOT_SIGNAL_TIMER0 signals correctly unless it uses priority MPSL_LOW_PRIO
 * or higher.
 */
#define TIMESLOT_IRQN          QDEC_IRQn
#define TIMESLOT_IRQ_NODELABEL qdec
#define TIMESLOT_IRQ_PRIO      4

/**
 * If TIMESLOT_CALLS_RADIO_IRQHANDLER is set then RADIO_IRQHandler() will be called
 * directly instead of executing the radio_irq callback.
 */
#define TIMESLOT_CALLS_RADIO_IRQHANDLER 1

enum TIMESLOT_ERROR
{
    /**
     * Could not get a granted timeslot using an "earliest" request. len_us is probably
     * too long for the current Connection Interval.
     */
    TIMESLOT_ERROR_REQUESTS_FAILED = 94,
    /** The MPSL complained because the timeslot did not close on time. */
    TIMESLOT_ERROR_OVERSTAYED = 93,
    /** Something unexpected happened. */
    TIMESLOT_ERROR_INTERNAL = 92,
    /** The timeslot_open function was called twice. */
    TIMESLOT_ERROR_SESSION_ALREADY_OPENED = 91,
    /**
     * The timeslot_start function was called before timeslot_stop completed (and executed
     * the stopped callback).
     */
    TIMESLOT_ERROR_TIMESLOT_ALREADY_STARTED = 90,
    /** The timeslot_stop function was called twice. */
    TIMESLOT_ERROR_NO_TIMESLOT_STARTED = 89,
    /** A required pointer was not included in an argument. */
    TIMESLOT_ERROR_INVALID_PARAM = 88
};

struct timeslot_config {
    /**
     * High frequency clock source, see MPSL_TIMESLOT_HFCLK_CFG.
     */
    uint8_t hfclk;        
    /**
     * Amount of time before a request times out.
     */
    uint32_t timeout_us;
    /**
     * Close the timeslot this amount of time before the end to ensure that it closes cleanly.
     */
    uint32_t safety_margin_us;
    /**
     * The number of skipped timeslots before an error is raised.
     */
    uint8_t skipped_tolerance;
};

#define TS_DEFAULT_CONFIG { \
    .hfclk             = MPSL_TIMESLOT_HFCLK_CFG_XTAL_GUARANTEED, \
    .timeout_us        = 2000000,                                 \
    .safety_margin_us  = 100,                                     \
    .skipped_tolerance = 5                                        \
}

struct timeslot_cb {
    /**
     * A (potentially unrecoverable) error has occurred. The err param will be set to a
     * TIMESLOT_ERROR or an error returned by an MPSL API call.
     */
    void (*error)(int err);
    /**
     * Called at the beginning of every timeslot.
     */
    void (*start)(void);
    /**
     * Called TS_SAFETY_MARGIN_US before the end of every timeslot.
     */
    void (*end)(void);
    /**
     * A timeslot has been blocked or cancelled. The count parameter is set to the number
     * of consecutive timeslots that have been skipped.
     */
    void (*skipped)(uint8_t count);
    /**
     * The recurring timeslot has been stopped (the session is idle).
     */
    void (*stopped)(void);

#if !TIMESLOT_USE_RADIO_IRQHANDLER
    /**
     * Some code e.g. the ESB library defines its own RADIO_IRQHandler function. Setting
     * TIMESLOT_USE_RADIO_IRQHANDLER causes MPSL_TIMESLOT_SIGNAL_RADIO signals to call
     * RADIO_IRQHandler directly. Otherwise, this callback will be used whenever RADIO_IRQHandler
     * is called.
     */
    void (*radio_irq)(void);
#endif
};

/** @brief Open an MPSL session
 * 
 * @note Opening a session is always the first step and closing a session is not implemented
 *       because there's no obvious reason to ever do it.
 *
 * @note This function should be called before Bluetooth is enabled.
 * 
 * @param[in] p_config      Pointer to a timeslot_config (should be static/global)
 * @param[in] p_cb          Pointer to a timeslot_cb (should be static/global)
 * 
 * @retval 0                                      Success
 * @retval -TIMESLOT_ERROR_SESSION_ALREADY_OPENED The session is already open
 * @retval -TIMESLOT_ERROR_INVALID_PARAM          One of the pointers was NULL
 */
int timeslot_open(struct timeslot_config *p_config, struct timeslot_cb *p_cb);

/** @brief Request a recurring timeslot of len_us
 * 
 * @param[in] len_us      Usable length will be minus safety_margin_us
 * 
 * @retval 0                                        Success
 * @retval -TIMESLOT_ERROR_TIMESLOT_ALREADY_STARTED The session is already open
 * @retval -NRF_EINVAL                              Invalid parameter
 * @retval -NRF_ENOENT                              The session is not open
 * @retval -NRF_EAGAIN                              The session is not IDLE
 */
int timeslot_start(uint32_t len_us);

/** @brief Stop requesting the recurring timeslot and allow the session to go idle
 *
 * @retval 0                                   Success
 * @retval -TIMESLOT_ERROR_NO_TIMESLOT_STARTED There is no timeslot to stop
 */
int timeslot_stop(void);

#ifdef __cplusplus
}
#endif

#endif /* TIMESLOT_H__ */

/** @} */
```

## src/esb.c
```c
/*
 * Nordic Enhanced ShockBurst (ESB) Protocol Implementation
 * 
 * This module implements the Nordic Enhanced ShockBurst protocol for
 * wireless communication between nRF52840 boards.
 */

#include "esb_link.h"
#include <zephyr/kernel.h>
#include <zephyr/device.h>
#include <zephyr/drivers/gpio.h>
#include <zephyr/logging/log.h>
#include <string.h>
#include <esb.h>

LOG_MODULE_REGISTER(esb, LOG_LEVEL_DBG);

/* Static variables */
static bool esb_initialized = false;
static bool esb_enabled = false;
static esb_rx_callback_t rx_callback = NULL;
static esb_tx_complete_callback_t tx_callback = NULL;
static esb_error_callback_t error_callback = NULL;

/* Statistics */
static uint32_t packets_sent = 0;
static uint32_t packets_received = 0;
static uint32_t packets_lost = 0;

/* Configuration */
static uint8_t current_channel = ESB_CHANNEL;
static int8_t current_power = 0;

/* ESB payload buffer */
static struct esb_payload tx_payload;
static struct esb_payload rx_payload;

/* Forward declarations */
static void esb_event_handler(struct esb_evt const *p_event);

/* ESB event handler */
static void esb_event_handler(struct esb_evt const *p_event)
{
    esb_packet_t packet;
    
    switch (p_event->evt_id) {
        case ESB_EVENT_TX_SUCCESS:
            packets_sent++;
            LOG_DBG("ESB TX success: pipe=%d", p_event->tx_success.pipe);
            
            if (tx_callback != NULL) {
                tx_callback(p_event->tx_success.pipe, true);
            }
            break;
            
        case ESB_EVENT_TX_FAILED:
            packets_lost++;
            LOG_WRN("ESB TX failed: pipe=%d", p_event->tx_failed.pipe);
            
            if (tx_callback != NULL) {
                tx_callback(p_event->tx_failed.pipe, false);
            }
            
            if (error_callback != NULL) {
                error_callback(0x01); /* TX failed error code */
            }
            break;
            
        case ESB_EVENT_RX_RECEIVED:
            while (esb_read_rx_payload(&rx_payload) == 0) {
                packets_received++;
                
                /* Fill packet structure */
                packet.pipe_id = rx_payload.pipe;
                packet.length = rx_payload.length;
                packet.rssi = rx_payload.rssi;
                packet.timestamp = k_cycle_get_32();
                packet.no_ack = rx_payload.noack;
                
                /* Copy payload data */
                memcpy(packet.data, rx_payload.data, 
                       rx_payload.length > ESB_MAX_PAYLOAD ? 
                       ESB_MAX_PAYLOAD : rx_payload.length);
                
                LOG_DBG("ESB RX: pipe=%d, len=%d, rssi=%d", 
                        packet.pipe_id, packet.length, packet.rssi);
                
                /* Call application callback */
                if (rx_callback != NULL) {
                    rx_callback(&packet);
                }
            }
            break;
            
        default:
            LOG_WRN("Unknown ESB event: %d", p_event->evt_id);
            if (error_callback != NULL) {
                error_callback(0x02); /* Unknown event error code */
            }
            break;
    }
}

/* Initialize ESB protocol */
int esb_init(void)
{
    int err;
    struct esb_config config = ESB_DEFAULT_CONFIG;
    
    if (esb_initialized) {
        return 0;
    }
    
    /* Configure ESB */
    config.protocol = ESB_PROTOCOL_ESB_DPL;  /* Dynamic Payload Length */
    config.mode = ESB_MODE_PTX;              /* Primary TX mode by default */
    config.event_handler = esb_event_handler;
    config.bitrate = ESB_BITRATE_1MBPS;      /* 1 Mbps to match UART speed */
    config.crc = ESB_CRC_16BIT;              /* 16-bit CRC for reliability */
    config.tx_output_power = ESB_TX_POWER_0DBM;
    config.retransmit_delay = 250;           /* 250µs delay */
    config.retransmit_count = 3;             /* 3 retransmissions */
    config.tx_mode = ESB_TXMODE_AUTO;        /* Auto mode */
    config.payload_length = ESB_DEFAULT_PAYLOAD;
    config.selective_auto_ack = false;
    
    /* Set RF channel */
    config.rf_channel = current_channel;
    
    /* Set mode based on compile-time flag */
    #if ESB_DEVICE_MODE == 0
    config.mode = ESB_MODE_PTX;  /* Primary TX */
    LOG_INF("Initializing ESB in Primary TX mode");
    #else
    config.mode = ESB_MODE_PRX;  /* Primary RX */
    LOG_INF("Initializing ESB in Primary RX mode");
    #endif
    
    /* Set base addresses */
    uint8_t base_addr_0[4] = {0xE7, 0xE7, 0xE7, 0xE7};
    uint8_t base_addr_1[4] = {0xC2, 0xC2, 0xC2, 0xC2};
    uint8_t addr_prefix[8] = {0xE7, 0xC2, 0xC3, 0xC4, 0xC5, 0xC6, 0xC7, 0xC8};
    
    memcpy(config.base_addr_0, base_addr_0, 4);
    memcpy(config.base_addr_1, base_addr_1, 4);
    memcpy(config.pipe_prefixes, addr_prefix, 8);
    
    /* Initialize ESB */
    err = esb_init(&config);
    if (err) {
        LOG_ERR("Failed to initialize ESB: %d", err);
        return -1;
    }
    
    esb_initialized = true;
    LOG_INF("ESB initialized successfully");
    
    return 0;
}

/* Enable ESB protocol */
int esb_enable(void)
{
    int err;
    
    if (!esb_initialized) {
        LOG_ERR("ESB not initialized");
        return -1;
    }
    
    if (esb_enabled) {
        return 0;
    }
    
    err = esb_enable();
    if (err) {
        LOG_ERR("Failed to enable ESB: %d", err);
        return -2;
    }
    
    esb_enabled = true;
    
    #if ESB_DEVICE_MODE == 0
    LOG_INF("ESB Primary TX enabled on channel %d", current_channel);
    #else
    LOG_INF("ESB Primary RX enabled on channel %d", current_channel);
    #endif
    
    return 0;
}

/* Disable ESB protocol */
int esb_disable(void)
{
    if (!esb_enabled) {
        return 0;
    }
    
    esb_disable();
    esb_enabled = false;
    LOG_INF("ESB disabled");
    
    return 0;
}

/* Set callbacks */
int esb_set_callbacks(esb_rx_callback_t rx_cb, 
                     esb_tx_complete_callback_t tx_cb,
                     esb_error_callback_t err_cb)
{
    rx_callback = rx_cb;
    tx_callback = tx_cb;
    error_callback = err_cb;
    
    LOG_DBG("ESB callbacks set");
    
    return 0;
}

/* Send packet */
int esb_send_packet(uint8_t pipe_id, uint8_t *data, uint8_t length, bool no_ack)
{
    int err;
    
    if (!esb_enabled) {
        LOG_ERR("ESB not enabled");
        return -1;
    }
    
    if (pipe_id >= ESB_PIPE_COUNT) {
        LOG_ERR("Invalid pipe ID: %d", pipe_id);
        return -2;
    }
    
    if (length > ESB_MAX_PAYLOAD) {
        LOG_ERR("Payload too large: %d", length);
        return -3;
    }
    
    if (data == NULL) {
        LOG_ERR("Invalid data pointer");
        return -4;
    }
    
    /* Prepare payload */
    tx_payload.pipe = pipe_id;
    tx_payload.length = length;
    tx_payload.noack = no_ack;
    memcpy(tx_payload.data, data, length);
    
    err = esb_write_payload(&tx_payload);
    if (err) {
        LOG_WRN("Failed to write ESB payload: %d", err);
        return -5;
    }
    
    LOG_DBG("ESB TX queued: pipe=%d, len=%d, no_ack=%d", pipe_id, length, no_ack);
    
    return 0;
}

/* Set channel */
int esb_set_channel(uint8_t channel)
{
    int err;
    
    if (channel > 100) {
        LOG_ERR("Invalid channel: %d", channel);
        return -1;
    }
    
    err = esb_set_rf_channel(channel);
    if (err) {
        LOG_ERR("Failed to set ESB channel: %d", err);
        return -2;
    }
    
    current_channel = channel;
    LOG_INF("ESB channel set to %d", channel);
    
    return 0;
}

/* Set power */
int esb_set_power(int8_t power_dbm)
{
    enum esb_tx_power power_level;
    int err;
    
    if (power_dbm >= 4) {
        power_level = ESB_TX_POWER_4DBM;
    } else if (power_dbm >= 0) {
        power_level = ESB_TX_POWER_0DBM;
    } else if (power_dbm >= -4) {
        power_level = ESB_TX_POWER_NEG4DBM;
    } else if (power_dbm >= -8) {
        power_level = ESB_TX_POWER_NEG8DBM;
    } else if (power_dbm >= -12) {
        power_level = ESB_TX_POWER_NEG12DBM;
    } else if (power_dbm >= -16) {
        power_level = ESB_TX_POWER_NEG16DBM;
    } else if (power_dbm >= -20) {
        power_level = ESB_TX_POWER_NEG20DBM;
    } else {
        power_level = ESB_TX_POWER_NEG30DBM;
    }
    
    err = esb_set_tx_power(power_level);
    if (err) {
        LOG_ERR("Failed to set ESB TX power: %d", err);
        return -1;
    }
    
    current_power = power_dbm;
    LOG_INF("ESB TX power set to %d dBm", power_dbm);
    
    return 0;
}

/* Set bitrate */
int esb_set_bitrate(uint32_t bitrate)
{
    enum esb_bitrate esb_bitrate;
    int err;
    
    switch (bitrate) {
        case 250000:
            esb_bitrate = ESB_BITRATE_250KBPS;
            break;
        case 1000000:
            esb_bitrate = ESB_BITRATE_1MBPS;
            break;
        case 2000000:
            esb_bitrate = ESB_BITRATE_2MBPS;
            break;
        default:
            LOG_ERR("Invalid bitrate: %d", bitrate);
            return -1;
    }
    
    err = esb_set_bitrate(esb_bitrate);
    if (err) {
        LOG_ERR("Failed to set ESB bitrate: %d", err);
        return -2;
    }
    
    LOG_INF("ESB bitrate set to %d bps", bitrate);
    
    return 0;
}

/* Set CRC */
int esb_set_crc(uint8_t crc_length)
{
    enum esb_crc crc_mode;
    int err;
    
    switch (crc_length) {
        case 0:
            crc_mode = ESB_CRC_OFF;
            break;
        case 1:
            crc_mode = ESB_CRC_8BIT;
            break;
        case 2:
            crc_mode = ESB_CRC_16BIT;
            break;
        default:
            LOG_ERR("Invalid CRC length: %d", crc_length);
            return -1;
    }
    
    err = esb_set_crc(crc_mode);
    if (err) {
        LOG_ERR("Failed to set ESB CRC: %d", err);
        return -2;
    }
    
    LOG_INF("ESB CRC set to %d bit", crc_length == 0 ? 0 : (crc_length == 1 ? 8 : 16));
    
    return 0;
}

/* Check if enabled */
bool esb_is_enabled(void)
{
    return esb_enabled;
}

/* Get statistics */
uint32_t esb_get_packets_sent(void)
{
    return packets_sent;
}

uint32_t esb_get_packets_received(void)
{
    return packets_received;
}

uint32_t esb_get_packets_lost(void)
{
    return packets_lost;
}
```
